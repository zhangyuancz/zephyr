## dts/bindings/sensor/megasenway,mc001.yaml
```yaml
# Copyright (c) 2026
# SPDX-License-Identifier: Apache-2.0

description: |
  Mega-senway MastCurr MC001 residual-current (leakage) detection module.

  An all-in-one digital type-B / A+6mA residual current device for EV charging.
  The module asserts its TRIP output when the residual current exceeds the
  action threshold, and accepts a zero-calibration pulse that should be issued
  once before each charging session.

  The TRIP edge is reported through a SENSOR_TRIG_THRESHOLD trigger, and the
  latched state is read with the SENSOR_CHAN_MC001_TRIP channel. The driver runs
  the power-on zero-calibration sequence automatically; it can be re-run with the
  SENSOR_ATTR_MC001_ZERO_CAL attribute.

  GPIO polarities are expressed at the SoC pin and already account for any board
  level signal inversion (e.g. an NPN buffer between the module and the MCU).

compatible: "megasenway,mc001"

include: sensor-device.yaml

properties:
  trip-gpios:
    type: phandle-array
    required: true
    description: |
      MCU input connected to the module TRIP output. Active level corresponds to
      a residual-current trip being asserted.

  zero-cal-gpios:
    type: phandle-array
    required: true
    description: |
      MCU output connected to the module Zero Cal. pin. Driving it active pulls
      the module calibration pin low to start a zero-current calibration.

  self-test-gpios:
    type: phandle-array
    description: |
      Optional MCU output connected to the module TEST pin. Driving it active
      injects a simulated residual current so the TRIP path can be verified
      without a real fault. When absent, SENSOR_ATTR_MC001_SELF_TEST returns
      -ENOTSUP.
```

## dts/bindings/watchdog/maxlinear,sp706.yaml
```yaml
# Copyright (c) 2026
# SPDX-License-Identifier: Apache-2.0

description: MaxLinear SP706 external watchdog

compatible: "maxlinear,sp706"

include: base.yaml

properties:
  wdi-gpios:
    type: phandle-array
    required: true
    description: |
      Watchdog input. Any rising or falling edge clears the watchdog timer.
      Leaving WDI high or low causes WDO to assert after the timeout.

  timeout-period:
    type: int
    default: 1600
    description: Nominal watchdog timeout in milliseconds.
```

## soc/gd/gd32/gd32e50x/Kconfig.defconfig.gd32e513
```kconfig
# Copyright (c) 2026
# SPDX-License-Identifier: Apache-2.0

if SOC_GD32E513

config SYS_CLOCK_HW_CYCLES_PER_SEC
	default 180000000

config NUM_IRQS
	default 87

endif # SOC_GD32E513
```

## soc/gd/gd32/gd32f5xx/Kconfig
```kconfig
# Copyright (c) 2026
# SPDX-License-Identifier: Apache-2.0

config SOC_SERIES_GD32F5XX
	select ARM
	select CPU_HAS_ARM_MPU
	select CPU_HAS_FPU
	select CPU_CORTEX_M33
	select ARMV8_M_DSP
	select GD32_HAS_AF_PINMUX
	select SOC_EARLY_INIT_HOOK

config GD32F5XX_SRAM_ECC_SCRUB
	bool "Scrub TCMSRAM and SRAM before reset init"
	default y if SOC_GD32F527
	select SOC_EARLY_RESET_HOOK
	help
	  GD32F527-specific: zero the full TCMSRAM and SRAM ranges in an early
	  reset hook, before the C runtime touches RAM-backed stacks, to prime
	  the SRAM ECC state (mirrors GigaDevice's startup code). The hook hard-
	  codes the F527 memory map, so it must only be enabled on that part.
	  Note: this runs on every reset and does not preserve any RAM contents
	  across a warm reset (no .noinit retention).

rsource "Kconfig.clocks"
```

## soc/gd/gd32/gd32f5xx/Kconfig.clocks
```kconfig
# Copyright (c) 2026
# SPDX-License-Identifier: Apache-2.0

choice GD32_F5XX_SYSCLK_SRC
	prompt "GD32F5xx 200 MHz system clock source"
	default GD32_F5XX_CLOCK_200M_8M_HXTAL
	help
	  Selects the oscillator that feeds the 200 MHz main PLL. The choice maps
	  to a __SYSTEM_CLOCK_* compile define in
	  zephyr/modules/hal_gigadevice/CMakeLists.txt, consumed by the HAL's
	  system_clock_config().

config GD32_F5XX_CLOCK_200M_8M_HXTAL
	bool "200 MHz from 8 MHz HXTAL (external crystal)"
	help
	  Configure the system clock to 200 MHz using an external 8 MHz HXTAL
	  crystal. Accurate, production default, but depends on the external
	  crystal starting reliably. If the crystal fails to oscillate the HAL
	  SystemInit() dead-loops before the app runs.

config GD32_F5XX_CLOCK_200M_IRC16M
	bool "200 MHz from internal IRC16M (no external crystal)"
	help
	  Configure the system clock to 200 MHz using the internal 16 MHz RC
	  oscillator, removing the external crystal dependency. IRC16M is only
	  ~1% accurate and drifts with temperature, so avoid this where high-baud
	  UART, USB, or CAN timing must be precise. Useful for board bring-up or
	  as a fallback when the external crystal is suspect.

endchoice
```

## soc/gd/gd32/gd32f5xx/Kconfig.defconfig.gd32f527
```kconfig
# Copyright (c) 2026
# SPDX-License-Identifier: Apache-2.0

if SOC_GD32F527

config SYS_CLOCK_HW_CYCLES_PER_SEC
	default 200000000

config NUM_IRQS
	default 104

endif # SOC_GD32F527
```

## soc/gd/gd32/gd32f5xx/Kconfig.defconfig.series
```kconfig
# Copyright (c) 2026
# SPDX-License-Identifier: Apache-2.0

if SOC_SERIES_GD32F5XX

rsource "Kconfig.defconfig.gd32*"

endif # SOC_SERIES_GD32F5XX
```

## soc/gd/gd32/gd32f5xx/Kconfig.soc
```kconfig
# Copyright (c) 2026
# SPDX-License-Identifier: Apache-2.0

config SOC_SERIES_GD32F5XX
	bool
	select SOC_FAMILY_GD_GD32
	help
	  Enable support for GigaDevice GD32F5XX MCU series

config SOC_SERIES
	default "gd32f5xx" if SOC_SERIES_GD32F5XX

config SOC_GD32F527
	bool
	select SOC_SERIES_GD32F5XX

config SOC
	default "gd32f527" if SOC_GD32F527
```
