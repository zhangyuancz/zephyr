## CMakeLists.txt
```
cmake_minimum_required(VERSION 3.20.0)

find_package(Zephyr REQUIRED HINTS $ENV{ZEPHYR_BASE})
project(l511c_bringup LANGUAGES C CXX)

# === C sources ===
target_sources(app PRIVATE src/main.c)

# === C++ OCPP bridge ===
set_source_files_properties(src/ocpp_bridge.cpp PROPERTIES LANGUAGE CXX)
target_sources(app PRIVATE src/ocpp_bridge.cpp)

# === C++ STL headers (overrides picolibc's -nostdinc++) ===
# Zephyr SDK's full C++ STL is available but blocked by -nostdinc++
# We add the include paths explicitly for C++ files only
set(SDK_SYSROOT /Users/yuan/zephyr-sdk-1.0.1/gnu/arm-zephyr-eabi/arm-zephyr-eabi)
set(CXX_HEADER_ROOT ${SDK_SYSROOT}/include/c++/14.3.0)
# Target-specific C++ headers (c++config.h etc.)
execute_process(COMMAND ${CMAKE_CXX_COMPILER} -mcpu=cortex-m33 -mthumb -mfp16-format=ieee -print-multi-directory
  OUTPUT_VARIABLE MULTI_DIR OUTPUT_STRIP_TRAILING_WHITESPACE)
target_include_directories(app SYSTEM PRIVATE
  $<$<COMPILE_LANGUAGE:CXX>:${CXX_HEADER_ROOT}>
  $<$<COMPILE_LANGUAGE:CXX>:${CXX_HEADER_ROOT}/${MULTI_DIR}>
  $<$<COMPILE_LANGUAGE:CXX>:${CXX_HEADER_ROOT}/arm-zephyr-eabi/${MULTI_DIR}>
)

# Link C++ standard library (MicroOcpp needs std::string, new/delete, static ctors)
zephyr_link_libraries(stdc++ supc++)

# === MicroOcpp ===
file(GLOB_RECURSE MO_SOURCES
  ${CMAKE_CURRENT_SOURCE_DIR}/lib/MicroOcpp/src/*.cpp
  ${CMAKE_CURRENT_SOURCE_DIR}/lib/MicroOcpp/src/*.c
)
# Exclude files that need mbedTLS directly, or conflict with our adapter
list(FILTER MO_SOURCES EXCLUDE REGEX "FtpMbedTLS|CertificateMbedTLS|CertificateService|Platform\\.cpp")

foreach(src ${MO_SOURCES})
  set_source_files_properties(${src} PROPERTIES LANGUAGE CXX)
  target_sources(app PRIVATE ${src})
endforeach()

# === Include paths ===
target_include_directories(app PRIVATE
  ${CMAKE_CURRENT_SOURCE_DIR}/lib/MicroOcpp/src
  ${CMAKE_CURRENT_SOURCE_DIR}/lib/ArduinoJson/src
  ${CMAKE_CURRENT_SOURCE_DIR}/src
)

# === Build flags for MicroOcpp ===
target_compile_definitions(app PRIVATE
  MO_CUSTOM_WS
  MO_CUSTOM_CONSOLE
  MO_CUSTOM_TIMER
  MO_CUSTOM_RNG
  MO_PLATFORM=0
  MO_ENABLE_V201
  MO_OVERRIDE_ALLOCATION=1
  MO_CUSTOM_CONSOLE_MAXMSGSIZE=512
)
```

## sample.yaml
```
sample:
  description: Minimal bring-up sample for the LYNQ L511C-Y7PM modem
  name: L511C-Y7PM bring-up
tests:
  sample.drivers.modem.l511c_bringup:
    depends_on:
      - gpio
      - serial
    filter: dt_chosen_enabled("zephyr,modem-uart")
```

## prj.conf
```kconfig
# ============================================
# L511C OCPP on WSS (WebSocket Secure / TLS)
# GD32E513 + MicroOcpp + mbedTLS
# ============================================

# --- GPIO & Serial ---
CONFIG_GPIO=y
CONFIG_SERIAL=y
CONFIG_UART_INTERRUPT_DRIVEN=y
CONFIG_CONSOLE=y
CONFIG_UART_CONSOLE=y
CONFIG_PRINTK=y

# --- Memory ---
CONFIG_HEAP_MEM_POOL_SIZE=24576
CONFIG_MAIN_STACK_SIZE=6144
CONFIG_SYSTEM_WORKQUEUE_STACK_SIZE=4096
CONFIG_NET_MGMT_EVENT_STACK_SIZE=2048

# --- Networking (native IP stack) ---
CONFIG_NETWORKING=y
CONFIG_NET_NATIVE=y
CONFIG_NET_IPV4=y
CONFIG_NET_TCP=y
CONFIG_NET_UDP=y
CONFIG_NET_SOCKETS=y
CONFIG_DNS_RESOLVER=y
CONFIG_NET_SOCKETS_DNS_TIMEOUT=12000
CONFIG_NET_SOCKETS_CONNECT_TIMEOUT=15000
CONFIG_NET_CONTEXT_RCVTIMEO=y

# --- PPP L2 ---
CONFIG_NET_L2_PPP=y
CONFIG_NET_L2_PPP_OPTION_DNS_USE=y
CONFIG_NET_L2_PPP_PAP=y
CONFIG_NET_L2_PPP_PAP_USERNAME="cmnet"
CONFIG_NET_L2_PPP_PAP_PASSWORD="cmnet"
CONFIG_NET_L2_PPP_MGMT=y

# --- Modem subsystem ---
CONFIG_NET_MGMT=y
CONFIG_NET_MGMT_EVENT=y
CONFIG_NET_CONNECTION_MANAGER=y
CONFIG_MODEM_MODULES=y
CONFIG_MODEM_BACKEND_UART=y
CONFIG_MODEM_PPP=y
CONFIG_MODEM_PIPE=y

# --- HTTP & WebSocket Client (WSS / TLS) ---
CONFIG_HTTP_CLIENT=y
CONFIG_WEBSOCKET_CLIENT=y
CONFIG_WEBSOCKET_MAX_CONTEXTS=1

# mbedTLS
CONFIG_MBEDTLS=y
CONFIG_MBEDTLS_ENABLE_HEAP=y
CONFIG_MBEDTLS_HEAP_SIZE=24576
CONFIG_MBEDTLS_SSL_IN_CONTENT_LEN=3072
CONFIG_MBEDTLS_SSL_OUT_CONTENT_LEN=3072
CONFIG_MBEDTLS_SSL_PROTO_TLS1_2=y
CONFIG_MBEDTLS_CIPHERSUITE_TLS_ECDHE_RSA_WITH_AES_128_GCM_SHA256=y
CONFIG_MBEDTLS_CIPHERSUITE_TLS_ECDHE_ECDSA_WITH_AES_128_GCM_SHA256=y
CONFIG_PSA_WANT_KEY_TYPE_RSA_PUBLIC_KEY=y
CONFIG_PSA_WANT_ALG_SHA_1=y

# TLS Socket (mTLS)
CONFIG_NET_SOCKETS_SOCKOPT_TLS=y
CONFIG_NET_SOCKETS_TLS_MAX_CONTEXTS=1
CONFIG_NET_SOCKETS_TLS_CERT_VERIFY_CALLBACK=y

# SNTP time sync (required for TLS cert verification)
CONFIG_SNTP=y

# --- Network buffers ---
CONFIG_NET_BUF_RX_COUNT=30
CONFIG_NET_BUF_TX_COUNT=30
CONFIG_NET_BUF_DATA_SIZE=256

# --- Logging (immediate mode, ERR only, enable net_sock_tls ERR) ---
CONFIG_LOG=y
CONFIG_NET_LOG=y
CONFIG_LOG_DEFAULT_LEVEL=1
CONFIG_LOG_MODE_IMMEDIATE=y
CONFIG_NET_SOCKETS_LOG_LEVEL_ERR=y

# --- Random ---
CONFIG_TEST_RANDOM_GENERATOR=y

# --- POSIX ---
CONFIG_POSIX_API=y

# --- C++ support ---
CONFIG_CPP=y

# --- LittleFS filesystem (external SPI NOR flash) ---
CONFIG_SPI=y
CONFIG_SPI_NOR=y
CONFIG_FLASH=y
CONFIG_FLASH_MAP=y
CONFIG_FILE_SYSTEM=y
CONFIG_FILE_SYSTEM_LITTLEFS=y
CONFIG_FS_LITTLEFS_FMP_DEV=y
```

## src/main.c
```c
/*
 * Copyright (c) 2026
 * SPDX-License-Identifier: Apache-2.0
 *
 * L511C OCPP on WSS (WebSocket Secure / TLS with mTLS)
 * ACBoard + GD32E513
 */

#include <ctype.h>
#include <stdio.h>
#include <string.h>

#include <zephyr/device.h>
#include <zephyr/devicetree.h>
#include <zephyr/drivers/gpio.h>
#include <zephyr/kernel.h>
#include <zephyr/modem/backend/uart.h>
#include <zephyr/modem/pipe.h>
#include <zephyr/modem/ppp.h>
#include <zephyr/net/net_event.h>
#include <zephyr/net/net_if.h>
#include <zephyr/net/net_ip.h>
#include <zephyr/net/net_mgmt.h>
#include <zephyr/net/socket.h>
#include <zephyr/net/sntp.h>
#include <zephyr/net/tls_credentials.h>
#include <zephyr/net/websocket.h>
#include <zephyr/sys/printk.h>

#include <mbedtls/x509.h>
#include <mbedtls/x509_crt.h>

#include <gd32e50x_gpio.h>

#include "tls_certificates.h"
#include "ocpp_bridge.h"

/* ===== Board / Modem DT ===== */
#define USER_NODE       DT_PATH(zephyr_user)
#define MODEM_UART_NODE DT_CHOSEN(zephyr_modem_uart)

#define MODEM_RESET_PULSE_MS      DT_PROP(USER_NODE, modem_reset_pulse_ms)
#define MODEM_BOOT_DRAIN_MS       3000
#define MODEM_AT_WAIT_MS          5000
#define MODEM_AT_IDLE_TIMEOUT_MS  2000
#define MODEM_DIAL_TIMEOUT_MS     30000
#define MODEM_NET_POLL_COUNT      12
#define MODEM_NET_POLL_INTERVAL_MS 5000

#define MODEM_BACKEND_RX_BUF_SIZE 2048
#define MODEM_BACKEND_TX_BUF_SIZE 2048
#define MODEM_RESP_BUF_SIZE       768
#define MODEM_PDP_APN             "cmnet"
#define MODEM_PPP_BUF_SIZE        512
#define MODEM_PPP_MTU             1500

/* OCPP server (WSS / TLS) */
#define OCPP_SERVER_HOST  "47.111.208.192"
#define OCPP_SERVER_PORT  "6669"
#define OCPP_SERVER_PATH  "/ocppj/812345678"
#define OCPP_CHARGEBOX_ID "812345678"

/* WS temp buffer (used during handshake) */
#define WS_TEMP_BUF_LEN  1024

/* PPP events */
#define PPP_EVENT_CONNECTED     BIT(0)
#define PPP_EVENT_DISCONNECTED  BIT(1)
#define PPP_EVENT_DNS_READY     BIT(2)

/* GPIOs */
static const struct gpio_dt_spec modem_powerkey =
	GPIO_DT_SPEC_GET(USER_NODE, modem_powerkey_gpios);
static const struct gpio_dt_spec modem_reset =
	GPIO_DT_SPEC_GET(USER_NODE, modem_reset_gpios);
static const struct device *const modem_uart = DEVICE_DT_GET(MODEM_UART_NODE);

/* App data */
struct app_data {
	struct { uint8_t uart_rx[MODEM_BACKEND_RX_BUF_SIZE];
		 uint8_t uart_tx[MODEM_BACKEND_TX_BUF_SIZE]; } buffers;
	struct modem_backend_uart uart_backend;
	struct modem_pipe *uart_pipe;
};
static struct app_data app;
static bool modem_registered;

/* PPP */
MODEM_PPP_DEFINE(cell_ppp, NULL, CONFIG_KERNEL_INIT_PRIORITY_DEVICE,
		 MODEM_PPP_MTU, MODEM_PPP_BUF_SIZE);
#define CELL_IFACE modem_ppp_get_iface(&cell_ppp)
K_EVENT_DEFINE(ppp_events);

/* Net mgmt handlers */
static void l4_event_handler(uint64_t event, struct net_if *iface,
			     void *info, size_t info_length, void *user_data)
{
	ARG_UNUSED(info); ARG_UNUSED(info_length); ARG_UNUSED(user_data);
	if (iface != CELL_IFACE) { return; }
	switch (event) {
	case NET_EVENT_L4_CONNECTED:   k_event_post(&ppp_events, PPP_EVENT_CONNECTED); break;
	case NET_EVENT_DNS_SERVER_ADD:
	case NET_EVENT_DNS_SERVERS_RECONFIGURED: k_event_post(&ppp_events, PPP_EVENT_DNS_READY); break;
	case NET_EVENT_L4_DISCONNECTED: k_event_post(&ppp_events, PPP_EVENT_DISCONNECTED); break;
	}
}
NET_MGMT_REGISTER_EVENT_HANDLER(ppp_l4, NET_EVENT_L4_CONNECTED |
	NET_EVENT_L4_DISCONNECTED | NET_EVENT_DNS_SERVER_ADD |
	NET_EVENT_DNS_SERVERS_RECONFIGURED, l4_event_handler, NULL);

static void ppp_event_handler(uint64_t event, struct net_if *iface,
			      void *info, size_t info_length, void *user_data)
{
	ARG_UNUSED(info); ARG_UNUSED(info_length); ARG_UNUSED(user_data);
	if (iface != CELL_IFACE) { return; }
	switch (event) {
	case NET_EVENT_PPP_PHASE_DEAD:   printk("ppp: DEAD\n"); break;
	case NET_EVENT_PPP_PHASE_RUNNING: printk("ppp: RUN\n"); break;
	case NET_EVENT_PPP_CARRIER_ON:   printk("ppp: CARRIER ON\n"); break;
	case NET_EVENT_PPP_CARRIER_OFF:  printk("ppp: CARRIER OFF\n"); break;
	}
}
NET_MGMT_REGISTER_EVENT_HANDLER(ppp_phase, NET_EVENT_PPP_PHASE_DEAD |
	NET_EVENT_PPP_PHASE_RUNNING | NET_EVENT_PPP_CARRIER_ON |
	NET_EVENT_PPP_CARRIER_OFF, ppp_event_handler, NULL);

/* ===== Modem AT helpers ===== */

static void modem_dump_lines(const char *tag, const uint8_t *buf, size_t len)
{
	char line[160]; size_t line_len = 0;
	printk("%s: %uB\n", tag, (unsigned)len);
	for (size_t i = 0; i < len; i++) {
		uint8_t c = buf[i];
		if (c == '\r') { continue; }
		if (c == '\n') {
			if (line_len > 0U) {
				line[line_len] = '\0'; printk("%s: %s\n", tag, line);
				if (strstr(line, "+CEREG: 0,1")) { modem_registered = true; }
				line_len = 0;
			} continue;
		}
		if (line_len < sizeof(line)-1U) { line[line_len++] = isprint(c)?(char)c:'.'; }
	}
}

static int modem_prepare_gpios(void)
{
	if (!gpio_is_ready_dt(&modem_powerkey) || !gpio_is_ready_dt(&modem_reset))
		{ return -ENODEV; }
	gpio_pin_configure_dt(&modem_powerkey, GPIO_OUTPUT_INACTIVE);
	gpio_pin_configure_dt(&modem_reset, GPIO_OUTPUT_INACTIVE);
	return 0;
}

static int modem_backend_open(void)
{
	const struct modem_backend_uart_config cfg = {
		.uart = modem_uart, .receive_buf = app.buffers.uart_rx,
		.receive_buf_size = sizeof(app.buffers.uart_rx),
		.transmit_buf = app.buffers.uart_tx,
		.transmit_buf_size = sizeof(app.buffers.uart_tx),
	};
	app.uart_pipe = modem_backend_uart_init(&app.uart_backend, &cfg);
	if (!app.uart_pipe) { return -ENODEV; }
	return modem_pipe_open(app.uart_pipe, K_MSEC(100));
}

static int modem_write_all(const uint8_t *buf, size_t len)
{
	size_t off = 0; int64_t dl = k_uptime_get() + 1000;
	while (off < len) {
		int r = modem_pipe_transmit(app.uart_pipe, &buf[off], len-off);
		if (r < 0) { return r; }
		if (r == 0) { if (k_uptime_get() >= dl) return -ETIMEDOUT; k_msleep(1); continue; }
		off += r; dl = k_uptime_get() + 1000;
	}
	return 0;
}

static size_t modem_collect_response(uint8_t *buf, size_t size, int idle_ms)
{
	size_t t = 0; int64_t dl = k_uptime_get() + idle_ms;
	if (!size) { return 0; }
	while (k_uptime_get() < dl && t < size-1) {
		int r = modem_pipe_receive(app.uart_pipe, &buf[t], size-1-t);
		if (r < 0) { break; }
		if (r == 0) { k_msleep(5); continue; }
		t += r; dl = k_uptime_get() + idle_ms;
	}
	buf[t] = '\0'; return t;
}

static int modem_run_cmd(const char *cmd, int timeout_ms, const char *expect)
{
	uint8_t rsp[MODEM_RESP_BUF_SIZE];
	printk("AT: %s", cmd);
	if (modem_write_all((const uint8_t *)cmd, strlen(cmd)) < 0) { return -EIO; }
	size_t len = modem_collect_response(rsp, sizeof(rsp), timeout_ms);
	modem_dump_lines("AT", rsp, len);
	if (expect && !strstr((const char *)rsp, expect)) { return -EIO; }
	return 0;
}

static int modem_dial_ppp(void)
{
	char line[160]; size_t ll = 0; uint8_t b;
	printk("AT: ATD*99#\n");
	if (modem_write_all((const uint8_t *)"ATD*99#\r\n", 9) < 0) { return -EIO; }
	int64_t dl = k_uptime_get() + MODEM_DIAL_TIMEOUT_MS;
	while (k_uptime_get() < dl) {
		int r = modem_pipe_receive(app.uart_pipe, &b, 1);
		if (r < 0) { return r; }
		if (r == 0) { k_msleep(5); continue; }
		if (b == '\r') { continue; }
		if (b == '\n') {
			if (!ll) { continue; }
			line[ll] = '\0'; printk("AT: %s\n", line);
			if (!strcmp(line, "CONNECT")) { return 0; }
			ll = 0; continue;
		}
		if (ll < sizeof(line)-1) { line[ll++] = isprint(b)?(char)b:'.'; }
	}
	return -ETIMEDOUT;
}

static void modem_power_on_and_reset(void)
{
	gpio_pin_set_dt(&modem_powerkey, 1);
	gpio_pin_set_dt(&modem_reset, 1);
	k_msleep(MODEM_RESET_PULSE_MS);
	gpio_pin_set_dt(&modem_reset, 0);
}

static int modem_init_sequence(void)
{
	static const char *cmds[] = {
		"AT\r\n", "ATE0\r\n", "ATI\r\n", "AT+CPIN?\r\n", "AT+CSQ\r\n",
		"AT+CEREG?\r\n", "AT+ECICCID\r\n", "AT+CIMI\r\n", "AT+CGATT?\r\n",
		"AT+CGDCONT=1,\"IP\",\"" MODEM_PDP_APN "\"\r\n",
	};
	for (size_t i = 0; i < ARRAY_SIZE(cmds); i++) {
		if (modem_run_cmd(cmds[i], MODEM_AT_IDLE_TIMEOUT_MS, "OK") < 0) { return -EIO; }
	}
	for (size_t i = 0; i < MODEM_NET_POLL_COUNT; i++) {
		if (modem_registered) { return 0; }
		printk("net poll %u/%u\n", (unsigned)(i+1), (unsigned)MODEM_NET_POLL_COUNT);
		modem_run_cmd("AT+CSQ\r\n", MODEM_AT_IDLE_TIMEOUT_MS, "OK");
		modem_run_cmd("AT+CEREG?\r\n", MODEM_AT_IDLE_TIMEOUT_MS, "OK");
		if (modem_registered) { return 0; }
		k_msleep(MODEM_NET_POLL_INTERVAL_MS);
	}
	return -ETIMEDOUT;
}

/* ===== WSS connect (TLS + mTLS) ===== */

/* TLS verify callback: skip CN/SAN hostname check since server cert has no CN */
static int tls_verify_cb(void *data, mbedtls_x509_crt *crt, int depth, uint32_t *flags)
{
	ARG_UNUSED(data); ARG_UNUSED(crt); ARG_UNUSED(depth);
	*flags &= ~MBEDTLS_X509_BADCERT_CN_MISMATCH;
	return 0;
}

static uint8_t ws_temp_buf[WS_TEMP_BUF_LEN];

static int ws_connect(void)
{
	struct zsock_addrinfo hints = { .ai_family = AF_INET, .ai_socktype = SOCK_STREAM };
	struct zsock_addrinfo *ai = NULL;
	struct sockaddr_in peer = {0};
	struct websocket_request req;
	char addr[NET_IPV4_ADDR_LEN];
	sec_tag_t sec_tags[] = { CA_CERTIFICATE_TAG, CLIENT_CERT_TAG };
	int sock = -1, ws_fd = -1, ret;

	/* Register certificates for mTLS */
	ret = tls_credential_add(CA_CERTIFICATE_TAG, TLS_CREDENTIAL_CA_CERTIFICATE,
				 ca_certificate, sizeof(ca_certificate));
	if (ret < 0) { printk("CA cert add err: %d\n", ret); return ret; }
	printk("CA cert ok (tag=%d)\n", CA_CERTIFICATE_TAG);

	ret = tls_credential_add(CLIENT_CERT_TAG, TLS_CREDENTIAL_PUBLIC_CERTIFICATE,
				 client_certificate, sizeof(client_certificate));
	if (ret < 0) { printk("Client cert add err: %d\n", ret); return ret; }

	ret = tls_credential_add(CLIENT_CERT_TAG, TLS_CREDENTIAL_PRIVATE_KEY,
				 client_private_key, sizeof(client_private_key));
	if (ret < 0) { printk("Client key add err: %d\n", ret); return ret; }
	printk("Client cert+key ok (tag=%d)\n", CLIENT_CERT_TAG);

	/* Sync time for cert validity check */
	{
		struct sntp_time sntp_ts;
		struct timespec ts;
		printk("SNTP ...\n");
		ret = sntp_simple("203.107.6.88", 5000, &sntp_ts);
		if (ret < 0) { ret = sntp_simple("ntp.aliyun.com", 8000, &sntp_ts); }
		if (ret >= 0) {
			ts.tv_sec = (time_t)sntp_ts.seconds; ts.tv_nsec = 0;
			clock_settime(CLOCK_REALTIME, &ts);
			printk("SNTP ok\n");
		} else {
			/* Fallback: June 8, 2026 */
			ts.tv_sec = 1780876800; ts.tv_nsec = 0;
			clock_settime(CLOCK_REALTIME, &ts);
			printk("SNTP fail (%d), using hardcoded time\n", ret);
		}
	}

	/* DNS resolve */
	printk("resolve %s:%s\n", OCPP_SERVER_HOST, OCPP_SERVER_PORT);
	ret = zsock_getaddrinfo(OCPP_SERVER_HOST, OCPP_SERVER_PORT, &hints, &ai);
	if (ret != 0 || !ai) { ret = -ENOENT; goto out; }
	memcpy(&peer, ai->ai_addr, sizeof(peer));
	zsock_freeaddrinfo(ai); ai = NULL;
	zsock_inet_ntop(AF_INET, &peer.sin_addr, addr, sizeof(addr));
	printk("-> %s:%u\n", addr, ntohs(peer.sin_port));

	/* Test plain TCP connectivity first */
	printk("TCP test to %s:%u ...\n", addr, ntohs(peer.sin_port));
	{
		int tsock = zsock_socket(AF_INET, SOCK_STREAM, IPPROTO_TCP);
		if (tsock >= 0) {
			struct timeval tv = {.tv_sec = 10};
			zsock_setsockopt(tsock, SOL_SOCKET, SO_SNDTIMEO, &tv, sizeof(tv));
			int tret = zsock_connect(tsock, (struct sockaddr *)&peer, sizeof(peer));
			if (tret < 0) {
				printk("TCP test fail: %d\n", -errno);
			} else {
				printk("TCP test ok (SYN reached server)\n");
			}
			zsock_close(tsock);
		} else {
			printk("TCP test socket create fail: %d\n", -errno);
		}
	}

	/* TLS socket — mutual auth: verify server cert, skip hostname check */
	sock = zsock_socket(AF_INET, SOCK_STREAM, IPPROTO_TLS_1_2);
	if (sock < 0) { ret = -errno; goto out; }

	zsock_setsockopt(sock, SOL_TLS, TLS_SEC_TAG_LIST, sec_tags, sizeof(sec_tags));
	{
		int verify_req = TLS_PEER_VERIFY_REQUIRED;
		zsock_setsockopt(sock, SOL_TLS, TLS_PEER_VERIFY,
				 &verify_req, sizeof(verify_req));
	}
	/* Set hostname to prevent Zephyr's forced empty-string verification.
	 * Custom verify callback strips CN_MISMATCH — server cert has no CN,
	 * so hostname check against IP would always fail.
	 */
	zsock_setsockopt(sock, SOL_TLS, TLS_HOSTNAME,
			 OCPP_SERVER_HOST, sizeof(OCPP_SERVER_HOST) - 1);
	{
		struct zsock_tls_cert_verify_cb vfy_cb = {
			.cb = tls_verify_cb,
			.ctx = NULL,
		};
		zsock_setsockopt(sock, SOL_TLS, TLS_CERT_VERIFY_CALLBACK,
				 &vfy_cb, sizeof(vfy_cb));
	}
	{
		struct timeval tv = {.tv_sec = 15};
		zsock_setsockopt(sock, SOL_SOCKET, SO_RCVTIMEO, &tv, sizeof(tv));
		zsock_setsockopt(sock, SOL_SOCKET, SO_SNDTIMEO, &tv, sizeof(tv));
	}

	printk("TLS connecting ...\n");
	ret = zsock_connect(sock, (struct sockaddr *)&peer, sizeof(peer));
	if (ret < 0) { printk("TLS connect err: %d\n", -errno); ret = -errno; goto out; }
	printk("TLS ok\n");

	/* WebSocket upgrade over TLS */
	const char *ocpp_headers[] = {
		"Sec-WebSocket-Protocol: ocpp2.0\r\n",
		NULL
	};
	memset(&req, 0, sizeof(req));
	req.host = OCPP_SERVER_HOST; req.url = OCPP_SERVER_PATH;
	req.optional_headers = ocpp_headers;
	req.tmp_buf = ws_temp_buf; req.tmp_buf_len = sizeof(ws_temp_buf);
	ws_fd = websocket_connect(sock, &req, 15000, NULL);
	if (ws_fd < 0) { printk("ws upgrade err: %d\n", ws_fd); ret = ws_fd; goto out; }
	printk("WSS ok (fd=%d)\n", ws_fd);
	return ws_fd;

out:
	if (ws_fd >= 0) { websocket_disconnect(ws_fd); }
	if (sock >= 0)  { zsock_close(sock); }
	if (ai) { zsock_freeaddrinfo(ai); }
	return ret;
}

/* ===== Main ===== */

int main(void)
{
	printk("\n=== L511C OCPP on WSS ===\n\n");

	/*
	 * Release PB3/PB4/PB5 from JTAG (JTDO/JNTRST/JTDI) so they can
	 * be used for SPI2.  SW-DP on PA13/PA14 is kept for debugging.
	 */
	gpio_pin_remap_config(GPIO_SWJ_SWDPENABLE_REMAP, ENABLE);

	if (!device_is_ready(modem_uart)) { return 0; }
	if (modem_prepare_gpios() < 0) { return 0; }
	if (modem_backend_open() < 0) { return 0; }

	modem_power_on_and_reset();
	{ uint8_t b[MODEM_RESP_BUF_SIZE]; modem_collect_response(b, sizeof(b), MODEM_BOOT_DRAIN_MS); }
	k_msleep(MODEM_AT_WAIT_MS);

	if (modem_init_sequence() < 0) { return 0; }
	if (modem_dial_ppp() < 0) { return 0; }
	if (modem_ppp_attach(&cell_ppp, app.uart_pipe) < 0) { return 0; }
	net_if_carrier_on(CELL_IFACE); net_if_up(CELL_IFACE); net_if_dormant_off(CELL_IFACE);

	printk("wait PPP ...\n");
	if (k_event_wait(&ppp_events, PPP_EVENT_CONNECTED, false, K_SECONDS(120)) != PPP_EVENT_CONNECTED)
		{ printk("PPP timeout\n"); return 0; }
	printk("PPP ok\n");
	k_event_wait(&ppp_events, PPP_EVENT_DNS_READY, false, K_SECONDS(30));
	k_msleep(1000);

	int ws_fd = ws_connect();
	if (ws_fd < 0) { printk("WS fail: %d\n", ws_fd); return 0; }

	printk("OCPP bridge start ...\n");
	ocpp_bridge_start(ws_fd, OCPP_SERVER_HOST, OCPP_CHARGEBOX_ID);
	return 0;
}
```

## src/Arduino.h
```c
/*
 * Minimal Arduino compatibility shim for Zephyr RTOS
 * Provides the bare minimum for MicroOcpp to compile.
 */
#ifndef ARDUINO_COMPAT_H
#define ARDUINO_COMPAT_H

#include <zephyr/kernel.h>
#include <zephyr/sys/printk.h>
#include <cstdint>
#include <cstddef>
#include <cstdlib>
#include <cstring>
#include <cstdio>

/* Arduino types */
typedef uint8_t byte;
typedef bool boolean;
#define String char /* not a real String, just for type compatibility */

/* Time */
inline unsigned long millis(void) { return (unsigned long)k_uptime_get(); }
inline unsigned long micros(void) { return (unsigned long)k_uptime_ticks() * 1000 / CONFIG_SYS_CLOCK_TICKS_PER_SEC; }
inline void delay(unsigned long ms) { k_msleep(ms); }

/* Serial stub */
#define Serial 0

/* Print format macros */
#define PSTR(x) x
#define F(x) x

/* Arduino pin functions (stubs) */
#define OUTPUT 1
#define INPUT 0
#define HIGH 1
#define LOW 0
inline void pinMode(int pin, int mode) {}
inline void digitalWrite(int pin, int val) {}
inline int digitalRead(int pin) { return 0; }

/* Memory */
#define PROGMEM

/* Standard functions Arduino usually provides */
inline char *itoa(int val, char *s, int radix) {
    if (radix == 10) { snprintf(s, 16, "%d", val); }
    else if (radix == 16) { snprintf(s, 16, "%x", val); }
    else if (radix == 8) { snprintf(s, 16, "%o", val); }
    return s;
}

inline char *ltoa(long val, char *s, int radix) {
    if (radix == 10) { snprintf(s, 32, "%ld", val); }
    return s;
}

inline char *ultoa(unsigned long val, char *s, int radix) {
    if (radix == 10) { snprintf(s, 32, "%lu", val); }
    return s;
}

/* dtostrf - float to string (Arduino style) */
inline char *dtostrf(double val, int width, int prec, char *s) {
    snprintf(s, width + 2, "%*.*f", width, prec, val);
    return s;
}

#endif /* ARDUINO_COMPAT_H */
```

## src/ca_certificate.h
```c
/*
 * Copyright (c) 2026
 *
 * SPDX-License-Identifier: Apache-2.0
 *
 * CA Certificate for WSS test server (wss-test-ca)
 * DER format, generated from ca.der
 */

#ifndef CA_CERTIFICATE_H
#define CA_CERTIFICATE_H

#define CA_CERTIFICATE_TAG 1

static const unsigned char ca_certificate[] = {
	0x30, 0x82, 0x03, 0x95, 0x30, 0x82, 0x02, 0x7d, 0xa0, 0x03, 0x02, 0x01,
	0x02, 0x02, 0x14, 0x1f, 0xa1, 0xa6, 0xfc, 0x7d, 0x48, 0xdf, 0x86, 0x62,
	0x21, 0x3e, 0x06, 0x6b, 0x7b, 0xd2, 0x99, 0x43, 0x3a, 0xc5, 0xf1, 0x30,
	0x0d, 0x06, 0x09, 0x2a, 0x86, 0x48, 0x86, 0xf7, 0x0d, 0x01, 0x01, 0x0b,
	0x05, 0x00, 0x30, 0x5a, 0x31, 0x0b, 0x30, 0x09, 0x06, 0x03, 0x55, 0x04,
	0x06, 0x13, 0x02, 0x43, 0x4e, 0x31, 0x10, 0x30, 0x0e, 0x06, 0x03, 0x55,
	0x04, 0x08, 0x0c, 0x07, 0x42, 0x65, 0x69, 0x6a, 0x69, 0x6e, 0x67, 0x31,
	0x10, 0x30, 0x0e, 0x06, 0x03, 0x55, 0x04, 0x07, 0x0c, 0x07, 0x42, 0x65,
	0x69, 0x6a, 0x69, 0x6e, 0x67, 0x31, 0x11, 0x30, 0x0f, 0x06, 0x03, 0x55,
	0x04, 0x0a, 0x0c, 0x08, 0x57, 0x53, 0x53, 0x2d, 0x54, 0x65, 0x73, 0x74,
	0x31, 0x14, 0x30, 0x12, 0x06, 0x03, 0x55, 0x04, 0x03, 0x0c, 0x0b, 0x77,
	0x73, 0x73, 0x2d, 0x74, 0x65, 0x73, 0x74, 0x2d, 0x63, 0x61, 0x30, 0x1e,
	0x17, 0x0d, 0x32, 0x36, 0x30, 0x36, 0x30, 0x31, 0x30, 0x35, 0x35, 0x39,
	0x35, 0x34, 0x5a, 0x17, 0x0d, 0x33, 0x36, 0x30, 0x35, 0x32, 0x39, 0x30,
	0x35, 0x35, 0x39, 0x35, 0x34, 0x5a, 0x30, 0x5a, 0x31, 0x0b, 0x30, 0x09,
	0x06, 0x03, 0x55, 0x04, 0x06, 0x13, 0x02, 0x43, 0x4e, 0x31, 0x10, 0x30,
	0x0e, 0x06, 0x03, 0x55, 0x04, 0x08, 0x0c, 0x07, 0x42, 0x65, 0x69, 0x6a,
	0x69, 0x6e, 0x67, 0x31, 0x10, 0x30, 0x0e, 0x06, 0x03, 0x55, 0x04, 0x07,
	0x0c, 0x07, 0x42, 0x65, 0x69, 0x6a, 0x69, 0x6e, 0x67, 0x31, 0x11, 0x30,
	0x0f, 0x06, 0x03, 0x55, 0x04, 0x0a, 0x0c, 0x08, 0x57, 0x53, 0x53, 0x2d,
	0x54, 0x65, 0x73, 0x74, 0x31, 0x14, 0x30, 0x12, 0x06, 0x03, 0x55, 0x04,
	0x03, 0x0c, 0x0b, 0x77, 0x73, 0x73, 0x2d, 0x74, 0x65, 0x73, 0x74, 0x2d,
	0x63, 0x61, 0x30, 0x82, 0x01, 0x22, 0x30, 0x0d, 0x06, 0x09, 0x2a, 0x86,
	0x48, 0x86, 0xf7, 0x0d, 0x01, 0x01, 0x01, 0x05, 0x00, 0x03, 0x82, 0x01,
	0x0f, 0x00, 0x30, 0x82, 0x01, 0x0a, 0x02, 0x82, 0x01, 0x01, 0x00, 0xd6,
	0x9a, 0x50, 0xf4, 0xda, 0xa8, 0x73, 0x2c, 0x5a, 0x2c, 0x27, 0xd7, 0x1a,
	0x86, 0x6c, 0x19, 0x8a, 0xcc, 0x42, 0x80, 0xc3, 0xea, 0x03, 0x5b, 0xed,
	0xf1, 0xbd, 0x1d, 0xac, 0xcd, 0xaa, 0xea, 0x76, 0x2d, 0x77, 0xcb, 0x1c,
	0x9b, 0xed, 0x40, 0x54, 0x54, 0xfa, 0x91, 0x42, 0x0a, 0x72, 0x67, 0x0b,
	0xf5, 0x83, 0xfa, 0x86, 0x43, 0xc6, 0x36, 0x16, 0xcd, 0x3b, 0xe8, 0xd8,
	0x1a, 0xb7, 0x7a, 0xb7, 0x1a, 0x11, 0x24, 0xc7, 0x80, 0x5a, 0x87, 0xc1,
	0x83, 0x85, 0x5b, 0x22, 0x59, 0x76, 0x7c, 0x22, 0x65, 0xdb, 0xb5, 0x5c,
	0xa9, 0x37, 0x38, 0xc3, 0x8f, 0x7e, 0x88, 0xf8, 0xc0, 0x4a, 0x0b, 0x8b,
	0x08, 0xc4, 0x28, 0x30, 0xc0, 0x23, 0x31, 0x38, 0x3f, 0x2a, 0x3e, 0x05,
	0x03, 0x70, 0xde, 0xc1, 0x13, 0x59, 0xc8, 0x76, 0x91, 0xf7, 0x55, 0xff,
	0x71, 0x5c, 0xa4, 0x95, 0xbc, 0x06, 0x42, 0x8c, 0x81, 0x5d, 0x2f, 0x42,
	0xe2, 0xdc, 0xf9, 0x79, 0x3e, 0x94, 0xe8, 0x69, 0x68, 0xb2, 0x48, 0x50,
	0x71, 0xfd, 0x31, 0xd7, 0x77, 0x8e, 0xe3, 0x39, 0xbc, 0xdf, 0x1f, 0xcc,
	0x87, 0x27, 0xde, 0x1d, 0x2c, 0x8f, 0x6a, 0x96, 0xf1, 0xdf, 0x54, 0x29,
	0xef, 0xc7, 0x7b, 0x0a, 0x87, 0x21, 0x71, 0xaf, 0x10, 0x16, 0xe9, 0x01,
	0x4a, 0x9c, 0x9a, 0x91, 0x25, 0xeb, 0x2b, 0x9d, 0x99, 0xc4, 0xec, 0xbf,
	0x9e, 0xe8, 0xa8, 0x3d, 0x31, 0x38, 0x1b, 0x74, 0x93, 0xdc, 0x16, 0xd5,
	0x63, 0x7c, 0x15, 0x18, 0x83, 0x3a, 0x08, 0x63, 0xde, 0x26, 0x43, 0x0b,
	0xeb, 0x18, 0x9f, 0xeb, 0x8a, 0x9c, 0x23, 0xd9, 0x28, 0x44, 0x34, 0x6a,
	0xf9, 0x55, 0x00, 0x6f, 0x0a, 0xdc, 0x00, 0xb6, 0x13, 0xfb, 0x7e, 0xa0,
	0xba, 0x3a, 0x0b, 0xe1, 0x62, 0x31, 0xc7, 0x7d, 0xff, 0x3e, 0xb0, 0xf5,
	0x84, 0x77, 0x41, 0x02, 0x03, 0x01, 0x00, 0x01, 0xa3, 0x53, 0x30, 0x51,
	0x30, 0x1d, 0x06, 0x03, 0x55, 0x1d, 0x0e, 0x04, 0x16, 0x04, 0x14, 0xa5,
	0x29, 0x81, 0x17, 0x4f, 0x38, 0x97, 0xfb, 0x4a, 0xc2, 0xe8, 0xea, 0x3f,
	0xf2, 0xc3, 0xf8, 0x3c, 0x36, 0xd7, 0xc0, 0x30, 0x1f, 0x06, 0x03, 0x55,
	0x1d, 0x23, 0x04, 0x18, 0x30, 0x16, 0x80, 0x14, 0xa5, 0x29, 0x81, 0x17,
	0x4f, 0x38, 0x97, 0xfb, 0x4a, 0xc2, 0xe8, 0xea, 0x3f, 0xf2, 0xc3, 0xf8,
	0x3c, 0x36, 0xd7, 0xc0, 0x30, 0x0f, 0x06, 0x03, 0x55, 0x1d, 0x13, 0x01,
	0x01, 0xff, 0x04, 0x05, 0x30, 0x03, 0x01, 0x01, 0xff, 0x30, 0x0d, 0x06,
	0x09, 0x2a, 0x86, 0x48, 0x86, 0xf7, 0x0d, 0x01, 0x01, 0x0b, 0x05, 0x00,
	0x03, 0x82, 0x01, 0x01, 0x00, 0x47, 0x92, 0xec, 0xfc, 0x19, 0xda, 0xfe,
	0x70, 0x69, 0x8a, 0x0e, 0xc5, 0x6d, 0x6b, 0x4d, 0xbb, 0x92, 0x34, 0x26,
	0x76, 0x17, 0x93, 0x29, 0xd5, 0x87, 0xc0, 0xa4, 0x33, 0xaa, 0x0e, 0x8b,
	0xb3, 0x15, 0x5f, 0x24, 0x53, 0xa9, 0xd3, 0x4b, 0x23, 0x4d, 0xa5, 0xea,
	0xc8, 0xf3, 0x53, 0x75, 0xcc, 0x24, 0x15, 0x6f, 0xbe, 0x05, 0x4c, 0xf6,
	0xeb, 0x62, 0x11, 0x5f, 0xc2, 0x21, 0xfc, 0x7a, 0x2d, 0xf3, 0x62, 0x5e,
	0x17, 0x33, 0x3d, 0xec, 0x37, 0x09, 0xc0, 0xf0, 0xea, 0x8d, 0xaf, 0xf4,
	0x1c, 0x64, 0x50, 0x9c, 0xd5, 0x9d, 0x7c, 0x97, 0xd1, 0xb7, 0xf4, 0x74,
	0x77, 0x09, 0x32, 0x6a, 0xee, 0x68, 0x52, 0xe7, 0x01, 0x20, 0x2f, 0xb8,
	0x03, 0xc3, 0x66, 0x14, 0x51, 0x09, 0x5c, 0x32, 0x48, 0x1f, 0x0a, 0x5d,
	0x28, 0xe5, 0xc4, 0x10, 0x1b, 0x61, 0x63, 0xbc, 0xe6, 0x27, 0x43, 0xa1,
	0xb2, 0xb2, 0x86, 0x6b, 0x14, 0xd8, 0xa4, 0x02, 0x98, 0xf2, 0x28, 0x33,
	0x39, 0x9d, 0x88, 0x45, 0x70, 0x9f, 0xc1, 0xbe, 0x5e, 0x9c, 0xf0, 0x87,
	0x7b, 0xe9, 0x53, 0xdc, 0x1f, 0x69, 0x0f, 0xa8, 0xbd, 0x72, 0x37, 0xd7,
	0x5e, 0xb8, 0x67, 0xa0, 0xcf, 0x21, 0x82, 0x53, 0x06, 0x8d, 0xea, 0xc8,
	0x2c, 0x9b, 0x50, 0x53, 0xbf, 0xd8, 0x27, 0x69, 0x99, 0x9c, 0xec, 0x3c,
	0x34, 0xd0, 0x8c, 0x02, 0xcf, 0x72, 0x04, 0x9e, 0xd1, 0x19, 0x26, 0x2c,
	0x44, 0x62, 0x3d, 0x84, 0xe4, 0x26, 0xf3, 0x13, 0x41, 0x1b, 0x7d, 0xeb,
	0x7f, 0xe5, 0x24, 0xc1, 0x17, 0x8d, 0xa8, 0xd9, 0xd7, 0x01, 0x70, 0x5a,
	0x11, 0xcf, 0xe9, 0xd4, 0xff, 0xbc, 0xa5, 0x47, 0x4f, 0xeb, 0xcc, 0x39,
	0xc0, 0xbc, 0x2e, 0xae, 0x3c, 0xc3, 0x9c, 0x75, 0xa7, 0xef, 0x12, 0x5c,
	0xcf, 0x1e, 0xef, 0xa3, 0x17, 0x7e, 0xaf, 0x8c, 0x8a,
};

#endif /* CA_CERTIFICATE_H */
```

## src/ocpp_bridge.cpp
```c
/*
 * OCPP Bridge — Zephyr WebSocket adapter for MicroOcpp
 * SPDX-License-Identifier: Apache-2.0
 */

extern "C" {
#include <zephyr/kernel.h>
#include <zephyr/device.h>
#include <zephyr/devicetree.h>
#include <zephyr/drivers/uart.h>
#include <zephyr/net/websocket.h>
#include <zephyr/sys/printk.h>
#include <stdio.h>
}

#include <functional>
#include <memory>
#include <MicroOcpp.h>
#include <MicroOcpp/Core/Connection.h>
#include <MicroOcpp/Core/FilesystemAdapter.h>

/* ===== MO_CUSTOM_CONSOLE ===== */

char _mo_console_msg_buf[MO_CUSTOM_CONSOLE_MAXMSGSIZE];
extern "C" void _mo_console_out(const char *msg) {
	/* Print ERROR, WARN, info, and key OCPP events (Heartbeat, Boot, etc.) */
	bool show = false;
	if (strstr(msg, "ERROR") || strstr(msg, "WARN")) { show = true; }
	if (strstr(msg, "[MO] info")) { show = true; }
	if (strstr(msg, "request has been")) { show = true; }
	if (strstr(msg, "initialized")) { show = true; }
	if (strstr(msg, "send conf")) { show = true; }

	if (!show) { return; }

	static const struct device *uart;
	if (!uart) { uart = DEVICE_DT_GET(DT_CHOSEN(zephyr_console)); }
	for (const char *p = msg; *p && *p != '\n'; p++) {
		uart_poll_out(uart, *p);
	}
	uart_poll_out(uart, '\r');
	uart_poll_out(uart, '\n');
}

/* ===== MO_CUSTOM_TIMER ===== */

static unsigned long (*mo_tick_fn)() = nullptr;
extern "C" void mocpp_set_timer(unsigned long (*get_ms)()) { mo_tick_fn = get_ms; }
extern "C" unsigned long mocpp_tick_ms_custom() {
	return mo_tick_fn ? mo_tick_fn() : (unsigned long)k_uptime_get();
}

/* ===== MO_CUSTOM_RNG ===== */
static uint32_t mo_rng_seed = 12345;
extern "C" uint32_t mocpp_rng_custom() {
	mo_rng_seed = mo_rng_seed * 1103515245 + 12345;
	return mo_rng_seed;
}

/* ===== Zephyr WS Connection ===== */

static void uart_puts(const char *s) {
	static const struct device *uart;
	if (!uart) { uart = DEVICE_DT_GET(DT_CHOSEN(zephyr_console)); }
	for (const char *p = s; *p; p++) { uart_poll_out(uart, *p); }
	uart_poll_out(uart, '\r'); uart_poll_out(uart, '\n');
}

class ZephyrWSConnection : public MicroOcpp::Connection {
public:
	ZephyrWSConnection(int ws_fd) : ws_fd_(ws_fd) {}

	void loop() override {
		uint8_t buf[1024];
		uint64_t remaining = UINT64_MAX;
		uint32_t msg_type = 0;
		int ret = websocket_recv_msg(ws_fd_, buf, sizeof(buf)-1,
					     &msg_type, &remaining, 0);
		if (ret > 0) {
			if (msg_type & WEBSOCKET_FLAG_CLOSE) {
				printk("ocpp: ws close\n"); connected_ = false; return;
			}
			if (msg_type & WEBSOCKET_FLAG_PING) {
				websocket_send_msg(ws_fd_, nullptr, 0,
						   WEBSOCKET_OPCODE_PONG, true, true, 1000);
				return;
			}
			if (msg_type & (WEBSOCKET_FLAG_TEXT | WEBSOCKET_FLAG_BINARY)) {
				buf[ret] = '\0';
				/* Print received message (first 256 chars) */
				printk("OCPP<- %.*s%s\n", (ret > 256 ? 256 : ret),
				       (const char *)buf, ret > 256 ? "..." : "");
				if (recv_cb_) { recv_cb_((const char *)buf, (size_t)ret); }
			}
		} else if (ret == -EAGAIN) {
		} else if (ret == 0 || ret == -ENOTCONN) {
			connected_ = false;
		} else if (ret < 0) {
			printk("ocpp: ws err %d\n", ret);
		}
	}

	bool sendTXT(const char *msg, size_t length) override {
		/* Print sent message (first 256 chars) */
		printk("OCPP-> %.*s%s\n", ((int)length > 256 ? 256 : (int)length),
		       msg, length > 256 ? "..." : "");
		int ret = websocket_send_msg(ws_fd_, (const uint8_t *)msg, length,
					     WEBSOCKET_OPCODE_DATA_TEXT, true, true, 3000);
		return ret > 0;
	}

	void setReceiveTXTcallback(MicroOcpp::ReceiveTXTcallback &cb) override { recv_cb_ = cb; }
	unsigned long getLastConnected() override { return last_connected_; }
	bool isConnected() override { return connected_; }
	void setConnected(bool c) { connected_ = c; last_connected_ = k_uptime_get(); }

private:
	int ws_fd_;
	bool connected_ = true;
	unsigned long last_connected_ = 0;
	MicroOcpp::ReceiveTXTcallback recv_cb_;
};

/* ===== Filesystem adapter (stub, no persistence) ===== */

class ZephyrFileAdapter : public MicroOcpp::FileAdapter {
public:
	size_t read(char *buf, size_t len) override { return 0; }
	size_t write(const char *buf, size_t len) override { return 0; }
	size_t seek(size_t offset) override { return 0; }
	int read() override { return -1; }
};

class ZephyrFS : public MicroOcpp::FilesystemAdapter {
public:
	int stat(const char *path, size_t *size) override { return 0; }
	std::unique_ptr<MicroOcpp::FileAdapter> open(const char *fn, const char *mode) override {
		return nullptr;
	}
	bool remove(const char *fn) override { return false; }
	int ftw_root(std::function<int(const char *fpath)> fn) override { return 0; }
};

/* ===== Entry point ===== */

extern "C" void ocpp_bridge_start(int ws_fd, const char *server_host,
				   const char *charge_box_id)
{
	printk("ocpp: init box=%s\n", charge_box_id);

	static ZephyrWSConnection conn(ws_fd);
	conn.setConnected(true);
	static ZephyrFS fs;

	/* Route MO allocations via Zephyr heap (coalescing, less fragmentation) */
	mo_mem_set_malloc_free(
		[](size_t sz) -> void* { return k_malloc(sz); },
		[](void* p) { k_free(p); }
	);

	mocpp_initialize(conn,
		ChargerCredentials::v201("H1", "CAMS", "V1.1.1", "812345678"),
		std::shared_ptr<MicroOcpp::FilesystemAdapter>(&fs, [](MicroOcpp::FilesystemAdapter* p){}),
		false,
		MicroOcpp::ProtocolVersion(2, 0, 1));

	printk("ocpp: running\n");

	while (1) {
		mocpp_loop();
		conn.loop();
		k_msleep(10);
	}
}
```
