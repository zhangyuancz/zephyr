## dts/bindings/pwm/gd,gd32-pwm.yaml
```yaml
# Copyright (c) 2021 Teslabs Engineering S.L.
# SPDX-License-Identifier: Apache-2.0

description: GigaDevice GD32 PWM

compatible: "gd,gd32-pwm"

include: [base.yaml, pwm-controller.yaml, pinctrl-device.yaml]

properties:
  pinctrl-0:
    required: true

  pinctrl-names:
    required: true

  "#pwm-cells":
    const: 3

  gd,auxiliary-source-channel:
    type: int
    enum: [0, 1, 2, 3]
    description: PWM output channel whose pulse width drives the auxiliary channel

  gd,auxiliary-channel:
    type: int
    enum: [0, 1, 2, 3]
    description: Internal compare channel configured alongside the PWM output

  gd,auxiliary-pulse-ratio:
    type: array
    description: |
      Numerator and denominator used to derive the auxiliary compare value from
      the source pulse width. For example, <1 2> places the compare event at
      half of the active pulse. The denominator must be non-zero.

pwm-cells:
  - channel
  - period
  - flags
```

## dts/bindings/rtc/belling,bl5372.yaml
```yaml
# Copyright (c) 2026
# SPDX-License-Identifier: Apache-2.0

description: Belling BL5372 real-time clock

compatible: "belling,bl5372"

include:
  - name: rtc-device.yaml
  - name: i2c-device.yaml
```

## dts/bindings/sensor/belling,bl0942.yaml
```yaml
# Copyright (c) 2026
# SPDX-License-Identifier: Apache-2.0

description: |
  Shanghai Belling BL0942 single-phase energy metering IC (UART mode).

  The BL0942 is a child of the UART node it is wired to, for example:

      &uart4 {
          status = "okay";
          current-speed = <9600>;

          bl0942: bl0942 {
              compatible = "belling,bl0942";
              voltage-divider-ratio = <1951>;
              current-shunt-microohm = <1000>;
          };
      };

  The driver returns physical units (volts, amperes, watts, hertz) using the
  fixed conversion constants from the datasheet together with the two
  board-specific analog front-end values below. It assumes the chip's
  power-on default register configuration (16x current gain, 1.218 V internal
  reference).

compatible: "belling,bl0942"

include: [sensor-device.yaml, uart-device.yaml]

properties:
  voltage-divider-ratio:
    type: int
    required: true
    description: |
      Ratio between the mains voltage and the voltage presented to the VP pin,
      i.e. (R_high + R_low) / R_low of the external resistor divider. Used to
      scale the V_RMS register to the real line voltage.

  current-shunt-microohm:
    type: int
    default: 1000
    description: |
      Effective current-sense transimpedance in micro-ohms, i.e. the IP/IN
      differential voltage per ampere of line current. For a direct shunt this
      is the shunt resistance (default 1 mOhm reference design value). For a
      current transformer it is burden_resistance / turns_ratio (e.g. a 2000:1
      CT with a 1.5 ohm burden gives 0.75 mOhm = 750). Used to convert the
      I_RMS / WATT registers into real line current and power.
```
