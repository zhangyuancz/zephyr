## boards/gd/acboard/Kconfig.acboard
```kconfig
# Copyright (c) 2026
# SPDX-License-Identifier: Apache-2.0

config BOARD_ACBOARD
	select SOC_GD32E513
```

## boards/gd/acboard/acboard_defconfig
```kconfig
# Copyright (c) 2026
# SPDX-License-Identifier: Apache-2.0

CONFIG_ARM_MPU=y
CONFIG_HW_STACK_PROTECTION=y

CONFIG_CONSOLE=y
CONFIG_UART_CONSOLE=y
CONFIG_SERIAL=y

CONFIG_GPIO=y

# SPI NOR Flash + LittleFS
CONFIG_SPI=y
CONFIG_SPI_GD32=y
CONFIG_SPI_NOR=y
CONFIG_FLASH=y
CONFIG_FLASH_MAP=y
CONFIG_FILE_SYSTEM=y
CONFIG_FILE_SYSTEM_LITTLEFS=y
```

## boards/gd/acboard/board.yml
```yaml
board:
  name: acboard
  full_name: ACBoard
  vendor: gd
  socs:
    - name: gd32e513
```

## boards/gd/acboard_f527/board.yml
```yaml
board:
  name: acboard_f527
  full_name: ACBoard-F527
  vendor: gd
  socs:
    - name: gd32f527
```

## drivers/misc/control_pilot/Kconfig
```kconfig
# Copyright (c) 2026
# SPDX-License-Identifier: Apache-2.0

config CONTROL_PILOT
	bool "GB/T 18487.1 control-pilot driver"
	default y
	depends on DT_HAS_ZEPHYR_CONTROL_PILOT_ENABLED
	depends on PWM
	depends on ADC
	depends on GPIO
	select ADC_ASYNC
	help
	  Enable the GB/T 18487.1 control-pilot (CP) driver. Generates the CP PWM and
	  continuously acquires the hardware-triggered ADC and optional PWM feedback
	  in interrupt callbacks. The latest voltage, states 0 through 4, diode input,
	  and PWM feedback can then be read without waiting for a conversion.

if CONTROL_PILOT

config CONTROL_PILOT_INIT_PRIORITY
	int "Control-pilot init priority"
	default 91
	help
	  Control-pilot driver initialization priority in POST_KERNEL. Must be
	  after the PWM, ADC and GPIO drivers.

module = CONTROL_PILOT
module-str = control_pilot
source "subsys/logging/Kconfig.template.log_config"

endif # CONTROL_PILOT
```

## drivers/misc/i2616e/Kconfig
```kconfig
# Copyright (c) 2026
# SPDX-License-Identifier: Apache-2.0

config I2616E
	bool "BARROT i2616e BLE module"
	default y
	depends on DT_HAS_BARROT_I2616E_ENABLED
	depends on UART_ASYNC_API
	depends on GPIO
	select MODEM_MODULES
	select MODEM_BACKEND_UART
	help
	  Enable the UART AT-command driver for the BARROT i2616e BLE module.
	  The driver supports binary-safe PDU transfer, connection and pairing
	  events, configuration, negotiated MTU queries, and whitelist management.

if I2616E

config I2616E_INIT_PRIORITY
	int "i2616e init priority"
	default 90
	help
	  Driver initialization priority in POST_KERNEL. Must be after UART and
	  GPIO drivers.

config I2616E_EVENT_QUEUE_SIZE
	int "i2616e event queue depth"
	default 4
	range 1 32
	help
	  Number of asynchronous module events (connection, pairing, received
	  PDU, ...) that can be buffered before i2616e_get_event() consumes them.
	  Each slot holds a full event including its PDU payload.

module = I2616E
module-str = i2616e
source "subsys/logging/Kconfig.template.log_config"

endif # I2616E
```

## drivers/misc/relay/Kconfig
```kconfig
# Copyright (c) 2026
# SPDX-License-Identifier: Apache-2.0

config RELAY
	bool "GPIO relay / contactor driver"
	default y
	depends on DT_HAS_ZEPHYR_GPIO_RELAY_ENABLED
	select GPIO
	help
	  Enable the GPIO relay / contactor driver. Drives a multi-channel relay
	  with break-before-make sequencing and detects welded contacts from an
	  output-feedback input.

if RELAY

config RELAY_INIT_PRIORITY
	int "Relay init priority"
	default 90
	help
	  Relay driver initialization priority in POST_KERNEL. Must be after the
	  GPIO driver.

module = RELAY
module-str = relay
source "subsys/logging/Kconfig.template.log_config"

endif # RELAY
```

## drivers/misc/ws1850t/Kconfig
```kconfig
# Copyright (c) 2026
# SPDX-License-Identifier: Apache-2.0

config WS1850T
	bool "WS1850T contactless card reader"
	default y
	depends on DT_HAS_WISESUN_WS1850T_ENABLED
	depends on UART_INTERRUPT_DRIVEN
	depends on GPIO
	help
	  Enable the driver for the WiseSun WS1850T 13.56 MHz contactless card
	  reader (MFRC522 register-compatible, UART interface). Provides
	  ISO 14443-A card UID read through a device-specific API.

if WS1850T

config WS1850T_INIT_PRIORITY
	int "WS1850T init priority"
	default 90
	help
	  WS1850T driver initialization priority in POST_KERNEL. Must be after
	  the UART and GPIO drivers.

module = WS1850T
module-str = WS1850T
source "subsys/logging/Kconfig.template.log_config"

endif # WS1850T
```

## drivers/modem/Kconfig.lynq_l511
```kconfig
# Copyright (c) 2026
# SPDX-License-Identifier: Apache-2.0

config MODEM_LYNQ_L511
	bool "Lynq L511 LTE Cat.1 cellular modem"
	default y
	depends on DT_HAS_LYNQ_L511_ENABLED
	depends on NET_L2_PPP
	select MODEM
	select MODEM_MODULES
	select MODEM_BACKEND_UART
	select MODEM_CHAT
	select MODEM_PIPE
	select MODEM_PPP
	select NET_MGMT
	select NET_MGMT_EVENT
	select GPIO
	help
	  Driver for the Lynq L511 LTE Cat.1 modem. It powers the module, runs the
	  AT init/registration/dial scripts and brings up a PPP network interface.

if MODEM_LYNQ_L511

config MODEM_LYNQ_L511_APN
	string "Access point name (APN)"
	default "cmnet"
	help
	  APN used for the PDP context (AT+CGDCONT).

config MODEM_LYNQ_L511_INIT_PRIORITY
	int "Init priority"
	default 90
	help
	  Device initialization priority in POST_KERNEL. Must be after the UART and
	  GPIO drivers.

config MODEM_LYNQ_L511_THREAD_STACK_SIZE
	int "Bring-up thread stack size"
	default 2048

config MODEM_LYNQ_L511_THREAD_PRIORITY
	int "Bring-up thread priority"
	default 7

config MODEM_LYNQ_L511_DIAL_TIMEOUT_SEC
	int "PPP dial timeout in seconds"
	default 30
	help
	  Maximum time to wait for CONNECT after ATD*99#.

config MODEM_LYNQ_L511_REGISTRATION_RETRY_COUNT
	int "Network registration retry count"
	default 12
	help
	  Number of times to poll SIM/network readiness before restarting the
	  bring-up attempt.

config MODEM_LYNQ_L511_REGISTRATION_RETRY_INTERVAL_MS
	int "Network registration retry interval in milliseconds"
	default 3000

config MODEM_LYNQ_L511_SIM_READY_RESTART_RETRY_COUNT
	int "SIM-ready retry count before restarting bring-up"
	default 3
	help
	  Consecutive AT+CPIN? failures before closing the pipe and restarting the
	  whole bring-up attempt.

config MODEM_LYNQ_L511_BRINGUP_RETRY_INTERVAL_MS
	int "Bring-up retry interval in milliseconds"
	default 10000

config MODEM_LYNQ_L511_INIT_SCRIPT_TIMEOUT_SEC
	int "AT init script timeout in seconds"
	default 10

config MODEM_LYNQ_L511_QUERY_SCRIPT_TIMEOUT_SEC
	int "Short AT query script timeout in seconds"
	default 5

config MODEM_LYNQ_L511_IDENTITY_SCRIPT_TIMEOUT_SEC
	int "SIM identity query timeout in seconds"
	default 8

config MODEM_LYNQ_L511_ATTACH_SCRIPT_TIMEOUT_SEC
	int "Packet attach/PDP setup timeout in seconds"
	default 8

module = MODEM_LYNQ_L511
module-str = lynq_l511
source "subsys/logging/Kconfig.template.log_config"

endif # MODEM_LYNQ_L511
```

## drivers/rtc/Kconfig.bl5372
```kconfig
# Copyright (c) 2026
# SPDX-License-Identifier: Apache-2.0

config RTC_BL5372
	bool "Belling BL5372 Real-Time Clock driver"
	default y
	depends on DT_HAS_BELLING_BL5372_ENABLED
	select I2C
	help
	  Enable the Belling BL5372 I2C RTC driver.
```

## drivers/sensor/bl0942/Kconfig
```kconfig
# Copyright (c) 2026
# SPDX-License-Identifier: Apache-2.0

config BL0942
	bool "BL0942 single-phase energy metering IC"
	default y
	depends on DT_HAS_BELLING_BL0942_ENABLED
	depends on UART_INTERRUPT_DRIVEN
	help
	  Enable the UART driver for the Shanghai Belling BL0942 single-phase
	  energy metering IC. Provides voltage, current, active power and line
	  frequency through the sensor API.
```

## drivers/sensor/mc001/Kconfig
```kconfig
# Copyright (c) 2026
# SPDX-License-Identifier: Apache-2.0

config MC001
	bool "MC001 residual-current detection module"
	default y
	depends on DT_HAS_MEGASENWAY_MC001_ENABLED
	select GPIO
	help
	  Enable the driver for the Mega-senway MastCurr MC001 residual-current
	  (leakage) detection module. Reports the TRIP state through the sensor
	  API with a SENSOR_TRIG_THRESHOLD trigger and runs the zero-calibration
	  sequence.
```

## drivers/watchdog/Kconfig.maxlinear_sp706
```kconfig
# Copyright (c) 2026
# SPDX-License-Identifier: Apache-2.0

config WDT_MAXLINEAR_SP706
	bool "MaxLinear SP706 external watchdog driver"
	default y
	depends on DT_HAS_MAXLINEAR_SP706_ENABLED
	depends on GPIO
	select HAS_WDT_NO_CALLBACKS
	help
	  Enable the GPIO-fed watchdog in the MaxLinear SP706 supervisor.
	  Any rising or falling edge on WDI restarts its watchdog timer.
```

## dts/bindings/misc/barrot,i2616e.yaml
```yaml
description: BARROT i2616e BLE module using its UART AT command interface

compatible: "barrot,i2616e"

include: uart-device.yaml

properties:
  reset-gpios:
    type: phandle-array
    required: true
    description: Hardware reset signal, normally active low

  reset-assert-duration-ms:
    type: int
    default: 200
    description: Time to keep hardware reset asserted

  ready-timeout-ms:
    type: int
    default: 5000
    description: Time to wait for IM_READY after reset

  sleep-enable-gpios:
    type: phandle-array
    description: Optional module sleep-enable control signal
```

## dts/bindings/misc/wisesun,ws1850t.yaml
```yaml
# Copyright (c) 2026
# SPDX-License-Identifier: Apache-2.0

description: |
  WiseSun WS1850T 13.56 MHz contactless card reader (UART mode).

  An MFRC522 register-compatible ISO/IEC 14443 A/B reader. The chip is a child
  of the UART node it is wired to, for example:

      &usart1 {
          status = "okay";
          current-speed = <9600>;

          ws1850t: ws1850t {
              compatible = "wisesun,ws1850t";
              reset-gpios = <&gpiod 4 GPIO_ACTIVE_HIGH>;
          };
      };

compatible: "wisesun,ws1850t"

include: uart-device.yaml

properties:
  reset-gpios:
    type: phandle-array
    required: true
    description: |
      MCU output connected to the module reset (NRSTPD). Driving it active
      resets the reader. The active level already accounts for any board level
      signal inversion between the MCU and NRSTPD.
```

## dts/bindings/misc/zephyr,control-pilot.yaml
```yaml
# Copyright (c) 2026
# SPDX-License-Identifier: Apache-2.0

include: base.yaml

description: |
  GB/T 18487.1 control-pilot (CP) interface.

  Ties together the CP PWM generator, a hardware-triggered ADC measuring the CP
  positive-level voltage, an optional PWM capture for feedback, and the diode
  detection input. ADC and PWM feedback acquisition run continuously using
  interrupt callbacks after initialization; reading the CP device returns the
  latest complete values without starting a conversion. The CP state (0, 1/1',
  2/2', 3/3', 4, invalid, or unknown) is derived from the measured CP voltage
  and whether PWM is being output.

  The timer/ADC hardware configuration (prescalers, ADC trigger source, etc.)
  lives on the referenced nodes; this node only wires the resulting devices.

  Example:

      cp: control-pilot {
          compatible = "zephyr,control-pilot";
          pwms = <&pwm1 2 PWM_USEC(1000) PWM_POLARITY_NORMAL>,
                 <&pwm2 0 PWM_USEC(1000) PWM_POLARITY_NORMAL>;
          pwm-names = "cp", "feedback";
          io-channels = <&adc0 11>;
          diode-gpios = <&gpioc 2 GPIO_ACTIVE_HIGH>;
          adc-reference-millivolt = <3300>;
          sense-divider-resistors-ohms = <430000 150000>;
      };

compatible: "zephyr,control-pilot"

properties:
  pwms:
    type: phandle-array
    required: true
    description: |
      CP PWM generator (name "cp") and, optionally, a PWM capture channel for
      continuous feedback capture (name "feedback").

  pwm-names:
    type: string-array
    required: true
    description: Names for the pwms entries; must include "cp".

  io-channels:
    type: phandle-array
    required: true
    description: ADC channel measuring the (divided) CP voltage.

  io-channel-names:
    type: string-array
    description: Optional names for the io-channels entries.

  diode-gpios:
    type: phandle-array
    required: true
    description: Input asserted when the vehicle diode is detected.

  adc-reference-millivolt:
    type: int
    required: true
    min: 1
    description: ADC reference voltage in millivolts.

  sense-divider-resistors-ohms:
    type: array
    required: true
    description: |
      CP sense-divider resistance values in ohms: first the upper resistor from
      CP to the ADC sense node, then the lower resistor from the sense node to
      ground. For example, <430000 150000> gives Vadc / Vcp = 150 / (430 + 150).
      Both values must be non-zero.

  default-duty-permille:
    type: int
    default: 1000
    description: |
      PWM duty applied at init, in per mille. Defaults to 1000 (constant +12 V,
      standby / no current advertised).
```

## dts/bindings/misc/zephyr,gpio-relay.yaml
```yaml
# Copyright (c) 2026
# SPDX-License-Identifier: Apache-2.0

include: base.yaml

description: |
  GPIO-driven relay / contactor with weld (output-feedback) detection.

  The relay is built from a master enable gate and one control line per channel.
  A coil is energised only when both the enable gate and its channel control are
  asserted, so the driver applies break-before-make sequencing. A feedback input
  is active when the relay output is live; comparing it against the commanded
  state detects a welded contact (output live while commanded open).

  Example (two-pole contactor):

      relay: relay {
          compatible = "zephyr,gpio-relay";
          enable-gpios = <&gpioe 1 GPIO_ACTIVE_HIGH>;
          control-gpios = <&gpioe 2 GPIO_ACTIVE_HIGH>,
                          <&gpioe 3 GPIO_ACTIVE_HIGH>;
          weld-gpios = <&gpioe 4 GPIO_ACTIVE_LOW>;
      };

compatible: "zephyr,gpio-relay"

properties:
  enable-gpios:
    type: phandle-array
    required: true
    description: |
      Master enable gate. Asserted (together with a channel control) to energise
      a closed channel.

  control-gpios:
    type: phandle-array
    required: true
    description: |
      Per-channel relay coil control lines. Channel i corresponds to bit i of the
      mask passed to relay_set().

  weld-gpios:
    type: phandle-array
    required: true
    description: |
      Feedback input, active when the relay output is live. Used to detect a
      welded contact: output live while the relay is commanded open.

  settle-time-ms:
    type: int
    default: 5
    description: Break-before-make settle time in milliseconds.
```

## dts/bindings/modem/lynq,l511.yaml
```yaml
# Copyright (c) 2026
# SPDX-License-Identifier: Apache-2.0

description: |
  Lynq L511 LTE Cat.1 cellular modem.

  The modem is driven over its UART with a 3GPP AT command set and provides
  network connectivity through a PPP dial-up data session (ATD*99#). It is a
  child of the UART it is wired to:

    &usart0 {
        modem: l511 {
            compatible = "lynq,l511";
            mdm-power-gpios = <&gpioa 12 GPIO_ACTIVE_HIGH>;
            mdm-reset-gpios = <&gpioa 11 GPIO_ACTIVE_HIGH>;
        };
    };

compatible: "lynq,l511"

include: uart-device.yaml

properties:
  mdm-power-gpios:
    type: phandle-array
    required: true
    description: Modem power-key control signal.

  mdm-reset-gpios:
    type: phandle-array
    required: true
    description: Modem reset signal.

  reset-pulse-ms:
    type: int
    default: 200
    description: Duration of the power-on reset pulse.

  at-ready-delay-ms:
    type: int
    default: 5000
    description: Delay after reset before running the first AT init script.
```

## dts/bindings/mtd/gd,gd32-nv-flash-v4.yaml
```yaml
# Copyright (c) 2026
# SPDX-License-Identifier: Apache-2.0

description: |
  Flash memory binding of GD32 FMC v4.

  GD32 series use this type flash memory:
    - GD32F5xx

include: soc-nv-flash.yaml

compatible: "gd,gd32-nv-flash-v4"

properties:
  max-erase-time-ms:
    type: int
    required: true
    description: max erase time(millisecond) of a flash sector
```
